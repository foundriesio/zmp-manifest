## west.yml
```yaml
west:
  url: https://github.com/foundriesio/west
  revision: 1980f707d6cb2b71d3488420e928051cc0a9df13
manifest:
  defaults:
    remote: foundriesio
    revision: master
  remotes:
  - name: foundriesio
    url-base: https://github.com/foundriesio
  projects:
  - name: zephyr
    remote: foundriesio
    revision: 350cff330c1669373740a1567bd53d383632e17a
    west-commands: scripts/west-commands.yml
  - name: mcuboot
    remote: foundriesio
    revision: b5957328d65f6d423a664885d5ed3b5cd01fcba8
  - name: mbedtls
    remote: foundriesio
    revision: 60fbd5bdf05c223b641677204469b53c2ff39d4e
    path: mcuboot/sim/mcuboot-sys/mbedtls
  - name: tinycbor
    remote: foundriesio
    revision: f5a172b976de07f7bb37d2d24149d6c7a1e512e1
  - name: dm-lwm2m
    remote: foundriesio
    revision: 629936f8a0bdbf91aa84712f2d35231bd2bb0252
    path: zmp-samples/dm-lwm2m
  - name: zephyr_tools
    remote: foundriesio
    revision: 1eb94096f6d4e560beea5fbe13a9ac76490aed58
    west-commands: west-commands.yml
  - name: zmp-container
    remote: foundriesio
    revision: 331d912d3e95a610c330be133d10d3b375ac84fb
  self:
    path: zmp-manifest
```
